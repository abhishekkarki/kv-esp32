## main/Kconfig.projbuild
```kconfig
menu "Assignment Configuration"

config LED_GPIO
    int "LED GPIO pin number"
    range 0 34
    default 16
    help
        The GPIO pin number to toggle the (built-in) LED.
        Some GPIOs are used for other purposes (flash connections, etc.) and cannot be used for this purpose.
        GPIOs 35-39 are input-only and hence cannot be used as outputs.
    
endmenu
```
